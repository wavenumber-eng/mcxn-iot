## CMakeLists.txt
```
#-------------------------------------------------------------------------------
# Zephyr Example Application
#
# Copyright (c) 2021 Nordic Semiconductor ASA
# SPDX-License-Identifier: Apache-2.0

cmake_minimum_required(VERSION 3.13.1)

set(REMOTE_ZEPHYR_DIR ${CMAKE_CURRENT_BINARY_DIR}/../MIMXRT1176_CM4/zephyr)

find_package(Zephyr REQUIRED HINTS $ENV{ZEPHYR_BASE})

project(app LANGUAGES C CXX)

list(APPEND CMAKE_MODULE_PATH ${ZEPHYR_BASE}/modules/nanopb)
include(nanopb)

message(STATUS "${BOARD} compile as Master in this sample")

if(CONFIG_INCLUDE_REMOTE_DIR)
  target_include_directories(zephyr_interface
    INTERFACE ${REMOTE_ZEPHYR_DIR}/include/public)
endif()


zephyr_nanopb_sources(app ../proto/version.proto)
target_sources(app PRIVATE src/main.c
                      src/pwm_control.c)

target_include_directories(app PRIVATE ${CMAKE_CURRENT_SOURCE_DIR})

zephyr_include_directories(include)
```

## sample.yaml
```
# This file is provided so that the application can be compiled using Twister,
# the Zephyr testing tool. In this file, multiple combinations can be specified,
# so that you can easily test all of them locally or in CI.
sample:
  description: Phoenix microcontroller firmware
  name: phoenix-microcontroller 

common:
  sysbuild: true
  integration_platforms:
    - mimxrt1170_evk
    - phoenix_rt1176
tests:
  app.default: {}
  app.debug:
    extra_overlay_confs:
      - debug.conf

  sample.sysbuild.app.phoenix_rt1176_mimxrt1176_cm7:
    platform_allow:
      - phoenix_rt1176/mimxrt1176/cm7
    integration_platforms:
      - phoenix_rt1176/mimxrt1176/cm7
    extra_args:
      SB_CONF_FILE=sysbuild/phoenix_rt1176_mimxrt1176_cm7.conf
      hello_world_SNIPPET=phoenix-rt1176-cm7

    sample.sysbuild.app.phoenix_rt1176_mimxrt1176_cm4:
    platform_allow:
      - phoenix_rt1176/mimxrt1176/cm4
    integration_platforms:
      - phoenix_rt1176/mimxrt1176/cm4
    extra_args:
      SB_CONF_FILE=sysbuild/phoenix_rt1176_mimxrt1176_cm4.conf
      hello_world_SNIPPET=phoenix-rt1176-cm4
```

## prj.conf
```kconfig
# Copyright (c) 2021 Nordic Semiconductor ASA
# SPDX-License-Identifier: Apache-2.0
#
# This file contains selected Kconfig options for the application.

CONFIG_SENSOR=y

CONFIG_USB_DEVICE_STACK=y
CONFIG_USB_DEVICE_PRODUCT="Zephyr USB console sample"
CONFIG_USB_DEVICE_PID=0x0004
CONFIG_USB_DEVICE_INITIALIZE_AT_BOOT=n

CONFIG_SERIAL=y
CONFIG_CONSOLE=y
CONFIG_UART_CONSOLE=y
CONFIG_UART_LINE_CTRL=y

CONFIG_PRINTK=y
CONFIG_IPM=y
CONFIG_TIMESLICE_SIZE=1
CONFIG_MAIN_STACK_SIZE=2048
CONFIG_HEAP_MEM_POOL_SIZE=4096
CONFIG_OPENAMP=y
CONFIG_OPENAMP_SLAVE=n

CONFIG_INCLUDE_REMOTE_DIR=y
CONFIG_SECOND_CORE_MCUX=y

CONFIG_NANOPB=y

CONFIG_PWM=y
CONFIG_PWM_MCUX=y
CONFIG_MOTOR_PWM=y
CONFIG_CUSTOM_PWM=y
```

## src/main.c
```c
/*
 * Copyright (c) 2021 Nordic Semiconductor ASA
 * SPDX-License-Identifier: Apache-2.0
 */

#include <zephyr/kernel.h>
#include <zephyr/drivers/sensor.h>
#include <zephyr/logging/log.h>
#include <zephyr/devicetree.h>
#include <zephyr/drivers/gpio.h>
#include <drivers/board_id.h>
#include <drivers/tracker_sync.h>
#include <zephyr/usb/usb_device.h>
#include <zephyr/usb/usbd.h>
#include <zephyr/drivers/uart.h>
#include <app_version.h>

#include <zephyr/net/socket.h>
#include <zephyr/net/net_core.h>
#include <zephyr/net/net_if.h>
#include <zephyr/net/ethernet.h>
#include <zephyr/net/net_mgmt.h>

#include "pwm_control.h"
#include "version.pb.h"

LOG_MODULE_REGISTER(main, CONFIG_APP_LOG_LEVEL);

#define BLINK_PERIOD_MS_STEP 100U
#define BLINK_PERIOD_MS_MAX  1000U

#define MY_IPADDR { { { 192, 168, 1, 100 } } }
#define BROADCAST_PORT 4242

#if !DT_NODE_EXISTS(DT_NODELABEL(boardida))
//#error "Board ID Not defined"
#endif

//static const struct gpio_dt_spec board_id = GPIO_DT_SPEC_GET_OR(DT_NODELABEL(boardida), gpios, { 0 });

/** Workqueue stack size for bounding processing (this configuration is not optimized). */
#define EP_BOUND_WORK_Q_STACK_SIZE (512U)

static struct k_work ipm_work;
static struct k_work_q ep_bound_work_q;
static K_THREAD_STACK_DEFINE(ep_bound_work_q_stack, EP_BOUND_WORK_Q_STACK_SIZE);

static void ipm_callback_process(struct k_work* work)
{
	// printf("Into callback\n");
}

int main(void)
{

	if (usb_enable(NULL)) {
		printf("USB enable failed\n");
	}
	// for(uint8_t i =0; i<10; i++)
	// {
	// 	printk("Waiting sec %d\n", i);
	// 	k_sleep(K_MSEC(1000));
	// }

	printk("Hello world from %s\n", CONFIG_BOARD_TARGET);
	printk("Running on CM7\n");

	const struct device* board_id_device;

	board_id_device = DEVICE_DT_GET(DT_NODELABEL(board_id));

	const struct device* tracker_sync_device;

	tracker_sync_device = DEVICE_DT_GET(DT_NODELABEL(tracker_sync));

	if (!device_is_ready(board_id_device)) {
		LOG_ERR("Sensor not ready");
		return 0;
	}

	if (!device_is_ready(tracker_sync_device)) {
		LOG_ERR("Sensor not ready");
		return 0;
	}
	
	k_work_queue_init(&ep_bound_work_q);
	k_work_queue_start(&ep_bound_work_q, ep_bound_work_q_stack,
		K_THREAD_STACK_SIZEOF(ep_bound_work_q_stack),
		CONFIG_SYSTEM_WORKQUEUE_PRIORITY, NULL);
	
	k_work_init(&ipm_work, ipm_callback_process);

	tracker_sync_register_sync_in_kwork(tracker_sync_device, &ipm_work, &ep_bound_work_q);
	tracker_sync_set_sync_out_rate(tracker_sync_device, K_MSEC(100));
	
	pwm_configure();

	while (1) {
		enum BOARD_ID_ENUM id = board_id_get_board_id(board_id_device);
		char* boardName = board_id_get_name(board_id_device);
		// printf("The board ID is %d string = %s\n", id, boardName);
		// printf("App version "APP_VERSION_EXTENDED_STRING"\n" );
		pwm_update_duty_cycle();
		k_sleep(K_MSEC(1000));
	}

	return 0;
}
```

## include/pwm_control.h
```c
/*
 * Copyright (c) 2024 FARO
 *
 */

#ifndef PWM_CONTROL_H_
#define PWM_CONTROL_H_

#include <zephyr/device.h>
#include <zephyr/toolchain.h>

/**
 * @brief Configures PWM
 */
void pwm_configure();

/**
 * @brief Updates the duty cycle of the PWM signal
 */
void pwm_update_duty_cycle(void);


#endif /* PWM_CONTROL_H_ */
```

## src/pwm_control.c
```c
/*
 * Copyright (c) 2024 FARO
 *
 */

#include <zephyr/kernel.h>
#include <zephyr/devicetree.h>
#include <zephyr/device.h>
#include <zephyr/drivers/pwm.h>
#include <zephyr/logging/log.h>

/* Define PWM device aliases */
#define PWM_DEVICE_PWM0 DT_ALIAS(pwm3_pwm0)
#define PWM_DEVICE_PWM1 DT_ALIAS(pwm3_pwm1)
#define PWM_DEVICE_PWM2 DT_ALIAS(pwm3_pwm2)

#if !DT_NODE_HAS_STATUS(PWM_DEVICE_PWM0, okay)
#warning "PWM3-PWM0 device not defined"
#endif

#if !DT_NODE_HAS_STATUS(PWM_DEVICE_PWM1, okay)
#warning "PWM3-PWM1 device not defined"
#endif

#if !DT_NODE_HAS_STATUS(PWM_DEVICE_PWM2, okay)
#warning "PWM3-PWM2 device not defined"
#endif

LOG_MODULE_REGISTER(pwm_control, CONFIG_APP_LOG_LEVEL);

#define PWM_FREQUENCY_HZ (1000U)

const struct device *pwm_dev0 = DEVICE_DT_GET(PWM_DEVICE_PWM0);
const struct device *pwm_dev1 = DEVICE_DT_GET(PWM_DEVICE_PWM1);
const struct device *pwm_dev2 = DEVICE_DT_GET(PWM_DEVICE_PWM2);
static uint32_t pwm_period = 1000; 
static uint32_t pwm_val = 500;

void pwm_configure(void)
{
    if (!device_is_ready(pwm_dev0) || !device_is_ready(pwm_dev1) || !device_is_ready(pwm_dev2))
    {
        printk("Motor Control PWM device not ready");
        return;
    }
    
    int ret = pwm_set(pwm_dev0, 0, pwm_period, pwm_val, 0);
    if (ret) {
        printk("Failed to set PWM device 0\n");
    }

    ret = pwm_set(pwm_dev1, 0, pwm_period, pwm_val, 0);
    if (ret) {
        printk("Failed to set PWM device 1\n");
    }

    ret = pwm_set(pwm_dev2, 0, pwm_period, pwm_val, 0);
    if (ret) {
        printk("Failed to set PWM device 2\n");
    }

    printk("PWM devices configured\n");
}

void pwm_update_duty_cycle(void)
{
    printk("updating pwm dutycycle\n");

    int ret = pwm_set(pwm_dev0, 0, pwm_period, pwm_val, PWM_POLARITY_NORMAL);
    if (ret) {
        printk("Failed to update PWM0 motor dutycycle\n");
    }
    
    ret = pwm_set(pwm_dev1, 0, pwm_period, pwm_val, PWM_POLARITY_NORMAL);
    if (ret) {
        printk("Failed to update PWM1 motor dutycycle\n");
    }

    ret = pwm_set(pwm_dev2, 0, pwm_period, pwm_val, PWM_POLARITY_NORMAL);
    if (ret) {
        printk("Failed to update PWM2 motor dutycycle\n");
    }
}
```
