## applications/faro/pwm/boards/arm/phoenix_rt1176/Kconfig.phoenix_rt1176
```kconfig
#
# Copyright 2024 NXP
#
# SPDX-License-Identifier: Apache-2.0

config BOARD_PHOENIX_RT1176
	select SOC_PART_NUMBER_MIMXRT1176DVMAA
	select SOC_MIMXRT1176_CM7 if BOARD_PHOENIX_RT1176_MIMXRT1176_CM7
	select SOC_MIMXRT1176_CM4 if BOARD_PHOENIX_RT1176_MIMXRT1176_CM4
```

## applications/faro/pwm/boards/arm/phoenix_rt1176/Kconfig.sysbuild
```kconfig
# Copyright (c) 2024 Nordic Semiconductor ASA
# SPDX-License-Identifier: Apache-2.0

choice MCUBOOT_MODE
	prompt "MCUBOOT mode"
	bool
	default MCUBOOT_MODE_SWAP_WITHOUT_SCRATCH if BOARD_MIMXRT1170_EVK_MIMXRT1176_CM7
	default MCUBOOT_MODE_SWAP_WITHOUT_SCRATCH if BOARD_PHOENIX_RT1176_MIMXRT1176_CM7

config MCUBOOT_MODE_SWAP_WITHOUT_SCRATCH
	bool "Swap without scratch"
	
config MCUBOOT_MODE_SWAP_USING_SCRATCH
	bool "Swap using scratch"

endchoice
```

## applications/faro/pwm/boards/arm/phoenix_rt1176/board.yml
```yaml
board:
  name: phoenix_rt1176
  vendor: nxp
  socs:
    - name: mimxrt1176
  revision:
    format: "letter"
    default: "A"
    revisions:
      - name: "A"
      - name: "B"
```

## applications/faro/pwm/drivers/ethernet/phy/Kconfig
```kconfig
# Ethernet PHY drivers configuration options

# Copyright (c) 2021 IP-Logix Inc.
# SPDX-License-Identifier: Apache-2.0

menuconfig ETH_PHY_DRIVER_FARO
	bool "Ethernet PHY drivers FARO"
	default y if NET_L2_ETHERNET || ETH_DRIVER

if ETH_PHY_DRIVER


config PHY_MICROCHIP_LAN8830
	bool "Microchip LAN8830 PHY Driver"
	default y
	depends on DT_HAS_MICROCHIP_LAN8830_ENABLED
	depends on MDIO
	depends on GPIO || (!$(dt_compat_any_has_prop,$(DT_COMPAT_MICROCHIP_LAN8830),reset-gpios) && \
			    !$(dt_compat_any_has_prop,$(DT_COMPAT_MICROCHIP_LAN8830),int-gpios))
	help
	  Enable Microchip LAN8830 Ethernet PHY Driver


endif # "Ethernet PHY Drivers"
```

## applications/faro/pwm/dts/bindings/board_id/board-id-sim.yaml
```yaml
# Copyright (c) 2021 Nordic Semiconductor ASA
# SPDX-License-Identifier: Apache-2.0

description: |
  An example sensor that reads the GPIO level defined in input-gpios. The
  purpose of this sensor is to demonstrate how to create out-of-tree drivers.


compatible: "board-id-sim"

include: base.yaml

properties:
  simulated-id:
    type: int
    description: Board Configuration ID
    required: true
```

## applications/faro/pwm/dts/bindings/tracker_sync/tracker-sync-phoenix.yaml
```yaml
# Copyright (c) 2021 Nordic Semiconductor ASA
# SPDX-License-Identifier: Apache-2.0

description: |
  Interface for the tracker sync pins


compatible: "tracker-sync-phoenix"

include: base.yaml

properties:
  #sync-ins:
  #  type: phandle-array
  #  required: true
  #  description: Input to processor for sync.
  input-gpios:
    type: phandle-array
    required: true
    description: Input GPIO to be sensed.
  output-gpios:
    type: phandle-array
    required: true
    description: Input GPIO to be sensed.
```

## applications/faro/pwm/dts/bindings/tracker_sync/tracker-sync-sim.yaml
```yaml
# Copyright (c) 2021 Nordic Semiconductor ASA
# SPDX-License-Identifier: Apache-2.0

description: |
  Simulates the tracker sync.


compatible: "tracker-sync-sim"

include: base.yaml

properties:
  simulated-rate-ms:
    type: int
    description: Miliseconds between simulated sync pulses
    required: true
```

## applications/faro/pwm/west.yml
```yaml
manifest:
  self:
    west-commands: scripts/west-commands.yml

  remotes:
    - name: zephyrproject-rtos
      url-base: https://github.com/zephyrproject-rtos
    - name: zephyrproject-rtos-faro
      url-base: git@ssh.dev.azure.com:v3/faro-us-hardware/Tracker.FW
    - name: ADM
      url-base: https://faro-us-hardware@dev.azure.com/faro-us-hardware/Tracker.FW/_git
    - name: AzZe
      url-base: https://faro-us-hardware@dev.azure.com/faro-us-hardware/Tracker.FW/_git
    - name: DPU
      url-base: https://faro-us-hardware@dev.azure.com/faro-us-hardware/Tracker.FW/_git

  projects:
    - name: Phoenix.ADM
      remote: ADM
      revision: main
    - name: Phoenix.AzZe
      remote: AzZe
      revision: main
    - name: Phoenix.DPU
      remote: DPU
      revision: main
    - name: zephyr
      remote: zephyrproject-rtos
      revision: v3.7.0
      import:
        # By using name-allowlist we can clone only the modules that are
        # strictly needed by the application.
        name-allowlist:
          - cmsis      # required by the ARM port
          - hal_nxp    # required by the mimxrt1170-evk board
          - mbedtls
          - open-amp
          - libmetal
          - nanopb
```

## applications/little_fs/ebug/Kconfig/arch/Kconfig
```kconfig
# Load arch Kconfig descriptions.
osource "C:/companies/wavenumber/mcxn-iot/zephyr/arch/x86/Kconfig"
osource "C:/companies/wavenumber/mcxn-iot/zephyr/arch/xtensa/Kconfig"
osource "C:/companies/wavenumber/mcxn-iot/zephyr/arch/sparc/Kconfig"
osource "C:/companies/wavenumber/mcxn-iot/zephyr/arch/riscv/Kconfig"
osource "C:/companies/wavenumber/mcxn-iot/zephyr/arch/posix/Kconfig"
osource "C:/companies/wavenumber/mcxn-iot/zephyr/arch/nios2/Kconfig"
osource "C:/companies/wavenumber/mcxn-iot/zephyr/arch/mips/Kconfig"
osource "C:/companies/wavenumber/mcxn-iot/zephyr/arch/arm64/Kconfig"
osource "C:/companies/wavenumber/mcxn-iot/zephyr/arch/arm/Kconfig"
osource "C:/companies/wavenumber/mcxn-iot/zephyr/arch/arc/Kconfig"
```

## boards/te/gibbon_d/Kconfig.gibbon_d
```kconfig
# Copyright 2024 NXP
# SPDX-License-Identifier: Apache-2.0

config BOARD_GIBBON_D
	select SOC_LPC55S69_CPU0 if BOARD_GIBBON_D_LPC55S69_CPU0 ||	\
								BOARD_GIBBON_D_LPC55S69_CPU0_NS
	select SOC_LPC55S69_CPU1 if BOARD_GIBBON_D_LPC55S69_CPU1
	select SOC_PART_NUMBER_LPC55S69JBD100
```

## boards/te/gibbon_d/board.yml
```yaml
board:
  name: gibbon_d
  vendor: nxp
  socs:
  - name: lpc55s69
    variants:
    - name: "ns"
      cpucluster: 'cpu0'
```

## boards/te/gibbon_d/gibbon_d_lpc55s69_cpu0_defconfig
```kconfig
CONFIG_SERIAL=y
CONFIG_GPIO=y
CONFIG_SYS_CLOCK_HW_CYCLES_PER_SEC=150000000
CONFIG_ARM_MPU=y
CONFIG_HW_STACK_PROTECTION=y
CONFIG_PINCTRL=y
CONFIG_INIT_PLL1=n


# Enable TrustZone-M
CONFIG_TRUSTED_EXECUTION_SECURE=y
CONFIG_ARM_TRUSTZONE_M=y

CONFIG_RUNTIME_NMI=y
```

## boards/te/gibbon_d/gibbon_d_lpc55s69_cpu1_defconfig
```kconfig
CONFIG_GPIO=y
CONFIG_SYS_CLOCK_HW_CYCLES_PER_SEC=150000000
CONFIG_PINCTRL=y
CONFIG_INIT_PLL1=n
CONFIG_CLOCK_CONTROL=y
CONFIG_BUILD_OUTPUT_HEX=y

CONFIG_RUNTIME_NMI=y
```

## drivers/Kconfig
```kconfig
# drivers configuration options

# Copyright (c) 2015 Intel Corporation
# SPDX-License-Identifier: Apache-2.0

#menu "FARO Device Drivers"


rsource "ethernet/Kconfig"
rsource "board_id/Kconfig"
rsource "tracker_sync/Kconfig"
rsource "motor_pwm/Kconfig"

#endmenu
```

## drivers/board_id/Kconfig
```kconfig
# Copyright (c) 2021 Nordic Semiconductor ASA
# SPDX-License-Identifier: Apache-2.0

config BOARD_ID_PHOENIX
	bool "Example sensor"
	default y
	depends on DT_HAS_BOARD_ID_PHOENIX_ENABLED
	select GPIO
	help
	  Enable example sensor

config BOARD_ID_SIM
	bool "Example sensor"
	default y
	depends on DT_HAS_BOARD_ID_SIM_ENABLED
	select GPIO
	help
	  Enable example sensor
```

## drivers/motor_pwm/Kconfig
```kconfig
# Copyright (c) 2024, FARO

config MOTOR_PWM
	bool "Motor PWM"
	default y
	help
	  Motor PWM driver

config CUSTOM_PWM
	bool "Custom PWM"
	default y
	help
		Custom PWM driver
```

## drivers/tracker_sync/Kconfig
```kconfig
# Copyright (c) 2021 Nordic Semiconductor ASA
# SPDX-License-Identifier: Apache-2.0

config TRACKER_SYNC_PHOENIX
	bool "Example sensor"
	default y
	depends on DT_HAS_TRACKER_SYNC_PHOENIX_ENABLED
	select GPIO
	help
	  Enable example sensor

config TRACKER_SYNC_SIM
	bool "Example sensor"
	default y
	depends on DT_HAS_TRACKER_SYNC_SIM_ENABLED
	select GPIO
	help
	  Enable example sensor
```

## dts/bindings/board_id/board-id-phoenix.yaml
```yaml
# Copyright (c) 2021 Nordic Semiconductor ASA
# SPDX-License-Identifier: Apache-2.0

description: |
  An example sensor that reads the GPIO level defined in input-gpios. The
  purpose of this sensor is to demonstrate how to create out-of-tree drivers.


compatible: "board-id-phoenix"

include: base.yaml

properties:
  input-gpios:
    type: phandle-array
    required: true
    description: Input GPIO to be sensed.
```

## dts/bindings/ethernet/microchip,lan8830.yaml
```yaml
# Copyright 2023-2024 NXP
# SPDX-License-Identifier: Apache-2.0

description: MICROCHIP LAN8830 Ethernet PHY device

compatible: "microchip,lan8830"

include: ethernet-phy.yaml

properties:
  reset-gpios:
    type: phandle-array
    description: GPIO connected to PHY reset signal pin. Reset is active low.
  int-gpios:
    type: phandle-array
    description: GPIO for interrupt signal indicating PHY state change.
```

## dts/bindings/motor_pwm/motor-pwm.yaml
```yaml
# Copyright (c) 2021 Nordic Semiconductor ASA
# SPDX-License-Identifier: Apache-2.0

description: |
  Simulates the tracker sync.

compatible: "motor-pwm"

include: [pwm-controller.yaml, pinctrl-device.yaml, base.yaml]

properties:
  index:
    type: int
    description: flexpwm submodule index
    required: true

  interrupts:
    required: true

  run-in-wait:
    type: boolean
    description: |
      Enable for PWM to keep running in WAIT mode.

  run-in-debug:
    type: boolean
    description: |
      Enable for PWM to keep running in debug mode.

  nxp,prescaler:
    type: int
    enum: [1, 2, 4, 8, 16, 32, 64, 128]
    required: true
    description: |
      Clock prescaler at the input of the PWM.

  nxp,reload:
    type: string
    enum:
      - "immediate"
      - "half-cycle"
      - "full-cycle"
      - "half-and-full-cycle"
    description: |
      Select how to load the buffered-registers with new values:
      "immediate" - buffered-registers get loaded with new values as soon as LDOK bit is set;
      "half-cycle" - registers loaded on a PWM half cycle;
      "full-cycle" - registers loaded on a PWM full cycle;
      "half-and-full-cycle" - registers loaded on a PWM half & full cycle.

  "#pwm-cells":
    const: 3

  mode:
    type: string
    enum:
      - "signed-center-aligned"
      - "center-aligned"
      - "signed-edge-aligned"
      - "edge-aligned"
    description: Mode of the PWM.
    required: true

  clock-source:
    type: int
    enum: [0, 1, 2]
    description: |
      Clock source for the PWM.
      0 - Bus Clock.
      1 - External Clock.
      2 - Submodule0 Clock.

  channel:
    type: int
    enum: [0, 1, 2]
    description: |
      PWM channel of the submodule
      0 - Channel B
      1 - Channel A
      2 - Channel X

  init-source:
    type: int
    enum: [0, 1, 2, 3]
    description: |
      Initial source for the PWM.
      0 - kPWM_Initialize_LocalSync.
      1 - kPWM_Initialize_MasterReload.
      2 - kPWM_Initialize_MasterSync.
      3 - kPWM_Initialize_ExtSync.

  dead-time:
    type: int
    description: Deadtime in nanoseconds.
    required: true

  pair-operation:
    type: int
    enum: [0, 1, 2]
    description: |
      Pair operation mode.
      0 - Independent mode.
      1 - Complementary PWMA mode.
      2 - Complementary PWMB mode.
    required: true

  pwm-freq:
    type: int
    description: Frequency in Hz.

  clock-freq:
    type: int
    description: Clock frequency in Hz.
  
pwm-cells:
  - channel
  - period
  - flags
```

## samples/dhcpv4_client/build/Kconfig/arch/Kconfig
```kconfig
# Load arch Kconfig descriptions.
osource "C:/ELI/mcxn-iot/zephyr/arch/x86/Kconfig"
osource "C:/ELI/mcxn-iot/zephyr/arch/xtensa/Kconfig"
osource "C:/ELI/mcxn-iot/zephyr/arch/sparc/Kconfig"
osource "C:/ELI/mcxn-iot/zephyr/arch/riscv/Kconfig"
osource "C:/ELI/mcxn-iot/zephyr/arch/posix/Kconfig"
osource "C:/ELI/mcxn-iot/zephyr/arch/nios2/Kconfig"
osource "C:/ELI/mcxn-iot/zephyr/arch/mips/Kconfig"
osource "C:/ELI/mcxn-iot/zephyr/arch/arm64/Kconfig"
osource "C:/ELI/mcxn-iot/zephyr/arch/arm/Kconfig"
osource "C:/ELI/mcxn-iot/zephyr/arch/arc/Kconfig"
```
