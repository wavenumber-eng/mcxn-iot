## samples/dhcpv4_client/build/Kconfig/soc/Kconfig
```kconfig
# Load Zephyr SoC Kconfig descriptions.
osource "C:/ELI/mcxn-iot/zephyr/soc/xlnx/zynqmp/Kconfig"
osource "C:/ELI/mcxn-iot/zephyr/soc/xlnx/zynq7000/Kconfig"
osource "C:/ELI/mcxn-iot/zephyr/soc/xen/Kconfig"
osource "C:/ELI/mcxn-iot/zephyr/soc/ti/simplelink/Kconfig"
osource "C:/ELI/mcxn-iot/zephyr/soc/ti/lm3s6965/Kconfig"
osource "C:/ELI/mcxn-iot/zephyr/soc/ti/k3/Kconfig"
osource "C:/ELI/mcxn-iot/zephyr/soc/telink/tlsr/Kconfig"
osource "C:/ELI/mcxn-iot/zephyr/soc/starfive/jh71xx/Kconfig"
osource "C:/ELI/mcxn-iot/zephyr/soc/st/stm32/Kconfig"
osource "C:/ELI/mcxn-iot/zephyr/soc/snps/qemu_arc/Kconfig"
osource "C:/ELI/mcxn-iot/zephyr/soc/snps/nsim/arc_v/Kconfig"
osource "C:/ELI/mcxn-iot/zephyr/soc/snps/nsim/arc_classic/Kconfig"
osource "C:/ELI/mcxn-iot/zephyr/soc/snps/hsdk4xd/Kconfig"
osource "C:/ELI/mcxn-iot/zephyr/soc/snps/hsdk/Kconfig"
osource "C:/ELI/mcxn-iot/zephyr/soc/snps/emsk/Kconfig"
osource "C:/ELI/mcxn-iot/zephyr/soc/snps/emsdp/Kconfig"
osource "C:/ELI/mcxn-iot/zephyr/soc/snps/arc_iot/Kconfig"
osource "C:/ELI/mcxn-iot/zephyr/soc/silabs/Kconfig"
osource "C:/ELI/mcxn-iot/zephyr/soc/sifive/sifive_freedom/Kconfig"
osource "C:/ELI/mcxn-iot/zephyr/soc/rockchip/Kconfig"
osource "C:/ELI/mcxn-iot/zephyr/soc/renode/riscv_virtual/Kconfig"
osource "C:/ELI/mcxn-iot/zephyr/soc/renesas/smartbond/Kconfig"
osource "C:/ELI/mcxn-iot/zephyr/soc/renesas/rzt2m/Kconfig"
osource "C:/ELI/mcxn-iot/zephyr/soc/renesas/rcar/Kconfig"
osource "C:/ELI/mcxn-iot/zephyr/soc/renesas/ra/Kconfig"
osource "C:/ELI/mcxn-iot/zephyr/soc/raspberrypi/Kconfig"
osource "C:/ELI/mcxn-iot/zephyr/soc/quicklogic/eos_s3/Kconfig"
osource "C:/ELI/mcxn-iot/zephyr/soc/qemu/virt_riscv/Kconfig"
osource "C:/ELI/mcxn-iot/zephyr/soc/qemu/malta/Kconfig"
osource "C:/ELI/mcxn-iot/zephyr/soc/openisa/rv32m1/Kconfig"
osource "C:/ELI/mcxn-iot/zephyr/soc/nxp/s32/Kconfig"
osource "C:/ELI/mcxn-iot/zephyr/soc/nxp/rw/Kconfig"
osource "C:/ELI/mcxn-iot/zephyr/soc/nxp/mcx/Kconfig"
osource "C:/ELI/mcxn-iot/zephyr/soc/nxp/lpc/Kconfig"
osource "C:/ELI/mcxn-iot/zephyr/soc/nxp/layerscape/Kconfig"
osource "C:/ELI/mcxn-iot/zephyr/soc/nxp/kinetis/Kconfig"
osource "C:/ELI/mcxn-iot/zephyr/soc/nxp/imxrt/Kconfig"
osource "C:/ELI/mcxn-iot/zephyr/soc/nxp/imx/Kconfig"
osource "C:/ELI/mcxn-iot/zephyr/soc/nuvoton/numicro/Kconfig"
osource "C:/ELI/mcxn-iot/zephyr/soc/nuvoton/numaker/Kconfig"
osource "C:/ELI/mcxn-iot/zephyr/soc/nuvoton/npcx/Kconfig"
osource "C:/ELI/mcxn-iot/zephyr/soc/nordic/Kconfig"
osource "C:/ELI/mcxn-iot/zephyr/soc/neorv32/Kconfig"
osource "C:/ELI/mcxn-iot/zephyr/soc/native/inf_clock/Kconfig"
osource "C:/ELI/mcxn-iot/zephyr/soc/microchip/miv/Kconfig"
osource "C:/ELI/mcxn-iot/zephyr/soc/microchip/mec/Kconfig"
osource "C:/ELI/mcxn-iot/zephyr/soc/mediatek/mtk_adsp/Kconfig"
osource "C:/ELI/mcxn-iot/zephyr/soc/lowrisc/opentitan/Kconfig"
osource "C:/ELI/mcxn-iot/zephyr/soc/litex/litex_vexriscv/Kconfig"
osource "C:/ELI/mcxn-iot/zephyr/soc/ite/ec/Kconfig"
osource "C:/ELI/mcxn-iot/zephyr/soc/intel/raptor_lake/Kconfig"
osource "C:/ELI/mcxn-iot/zephyr/soc/intel/lakemont/Kconfig"
osource "C:/ELI/mcxn-iot/zephyr/soc/intel/intel_socfpga_std/Kconfig"
osource "C:/ELI/mcxn-iot/zephyr/soc/intel/intel_socfpga/Kconfig"
osource "C:/ELI/mcxn-iot/zephyr/soc/intel/intel_niosv/Kconfig"
osource "C:/ELI/mcxn-iot/zephyr/soc/intel/intel_ish/Kconfig"
osource "C:/ELI/mcxn-iot/zephyr/soc/intel/intel_adsp/Kconfig"
osource "C:/ELI/mcxn-iot/zephyr/soc/intel/elkhart_lake/Kconfig"
osource "C:/ELI/mcxn-iot/zephyr/soc/intel/atom/Kconfig"
osource "C:/ELI/mcxn-iot/zephyr/soc/intel/apollo_lake/Kconfig"
osource "C:/ELI/mcxn-iot/zephyr/soc/intel/alder_lake/Kconfig"
osource "C:/ELI/mcxn-iot/zephyr/soc/infineon/cat3/Kconfig"
osource "C:/ELI/mcxn-iot/zephyr/soc/infineon/cat1b/Kconfig"
osource "C:/ELI/mcxn-iot/zephyr/soc/infineon/cat1a/Kconfig"
osource "C:/ELI/mcxn-iot/zephyr/soc/gd/gd32/Kconfig"
osource "C:/ELI/mcxn-iot/zephyr/soc/gaisler/leon3/Kconfig"
osource "C:/ELI/mcxn-iot/zephyr/soc/gaisler/gr716a/Kconfig"
osource "C:/ELI/mcxn-iot/zephyr/soc/espressif/Kconfig"
osource "C:/ELI/mcxn-iot/zephyr/soc/ene/kb1200/Kconfig"
osource "C:/ELI/mcxn-iot/zephyr/soc/efinix/sapphire/Kconfig"
osource "C:/ELI/mcxn-iot/zephyr/soc/cdns/xtensa_sample_controller/Kconfig"
osource "C:/ELI/mcxn-iot/zephyr/soc/cdns/dc233c/Kconfig"
osource "C:/ELI/mcxn-iot/zephyr/soc/brcm/bcmvk/Kconfig"
osource "C:/ELI/mcxn-iot/zephyr/soc/brcm/bcm2712/Kconfig"
osource "C:/ELI/mcxn-iot/zephyr/soc/brcm/bcm2711/Kconfig"
osource "C:/ELI/mcxn-iot/zephyr/soc/atmel/sam0/Kconfig"
osource "C:/ELI/mcxn-iot/zephyr/soc/atmel/sam/Kconfig"
osource "C:/ELI/mcxn-iot/zephyr/soc/aspeed/Kconfig"
osource "C:/ELI/mcxn-iot/zephyr/soc/arm/Kconfig"
osource "C:/ELI/mcxn-iot/zephyr/soc/arm/beetle/Kconfig"
osource "C:/ELI/mcxn-iot/zephyr/soc/andestech/Kconfig"
osource "C:/ELI/mcxn-iot/zephyr/soc/ambiq/Kconfig"
osource "C:/ELI/mcxn-iot/zephyr/soc/altr/zephyr_nios2f/Kconfig"
osource "C:/ELI/mcxn-iot/zephyr/soc/altr/qemu_nios2/Kconfig"
osource "C:/ELI/mcxn-iot/zephyr/soc/adi/max32/Kconfig"
```

## west.yml
```yaml
manifest:
  defaults:
    revision: main

  remotes:
    - name: zephyrproject-rtos
      url-base: https://github.com/zephyrproject-rtos

    - name: wn
      url-base: https://github.com/wavenumber-eng

    - name: nordic
      url-base: https://github.com/nrfconnect


  defaults:
    remote: zephyrproject-rtos
    revision: main

  projects:

    - name: golioth
      path: modules/lib/golioth-firmware-sdk
      revision: main
      url: https://github.com/golioth/golioth-firmware-sdk.git
      submodules: true
      
    - name: zephyr
      remote: zephyrproject-rtos
      repo-path: zephyr
      revision: v4.1.0-rc1
      import: true

    - name: wn_zephyr_modules   
      remote: wn    
      path: ./modules/wn_modules     
      revision: main

    - name: wn_zephyr_custom_boards
      remote: wn
      path: ./boards
      revision: main
     
    - name: bunny_build
      remote: wn
      revision: main
      path: modules/bunny_build


  self:
    path: mcxn-iot
    
```
