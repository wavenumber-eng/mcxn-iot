## prj.conf
```kconfig
CONFIG_NETWORKING=y
#CONFIG_NET_IPV6=n
CONFIG_NET_IPV4=y
#CONFIG_NET_ARP=y
#CONFIG_NET_UDP=y
CONFIG_NET_DHCPV4=y
CONFIG_NET_DHCPV4_OPTION_CALLBACKS=y
#CONFIG_DNS_RESOLVER=y
#
#CONFIG_TEST_RANDOM_GENERATOR=y
#
#CONFIG_INIT_STACKS=y
#
#CONFIG_NET_MGMT=y
#CONFIG_NET_MGMT_EVENT=y
#
#CONFIG_NET_LOG=y
#CONFIG_LOG=y
#
#CONFIG_SLIP_STATISTICS=n
#CONFIG_NET_SHELL=y

# Application
CONFIG_GOLIOTH_SAMPLE_COMMON=y
CONFIG_GOLIOTH_SAMPLE_HARDCODED_CREDENTIALS=y
CONFIG_LOG_BACKEND_GOLIOTH=y

# Golioth Firmware SDK with all dependencies
CONFIG_GOLIOTH_FIRMWARE_SDK=y

CONFIG_GOLIOTH_SAMPLE_PSK_ID="20240802183318-temperature-monitor-1@sapphire-imaginative-toad"
CONFIG_GOLIOTH_SAMPLE_PSK="ad311dea926969c7332533d3d180d3a9"

CONFIG_DNS_SERVER1=""
```

## boards/frdm_mcxn947_mcxn947_cpu0.conf
```kconfig
CONFIG_ENTROPY_GENERATOR=y
CONFIG_TEST_RANDOM_GENERATOR=y

CONFIG_GOLIOTH_SAMPLE_DHCP_BIND=y
CONFIG_NET_L2_ETHERNET=y
CONFIG_NET_DHCPV4=y

# DHCP configuration
#CONFIG_NETWORKING=y
#CONFIG_NET_IPV6=n
#CONFIG_NET_IPV4=y
#CONFIG_NET_ARP=y
#CONFIG_NET_UDP=y
#CONFIG_NET_DHCPV4=y
#CONFIG_NET_DHCPV4_OPTION_CALLBACKS=y
#CONFIG_DNS_RESOLVER=y
#
#CONFIG_TEST_RANDOM_GENERATOR=y
#
#CONFIG_INIT_STACKS=y
#
#CONFIG_NET_MGMT=y
#CONFIG_NET_MGMT_EVENT=y
#
#CONFIG_NET_LOG=y
#CONFIG_LOG=y
#
#CONFIG_SLIP_STATISTICS=n
#CONFIG_NET_SHELL=y
```

## src/main.c
```c
/* Networking DHCPv4 client */

/*
 * Copyright (c) 2017 ARM Ltd.
 * Copyright (c) 2016 Intel Corporation.
 *
 * SPDX-License-Identifier: Apache-2.0
 */

#include <zephyr/logging/log.h>
LOG_MODULE_REGISTER(net_dhcpv4_client_sample, LOG_LEVEL_DBG);

#include <zephyr/kernel.h>
#include <zephyr/linker/sections.h>
#include <errno.h>
#include <stdio.h>

#include <zephyr/net/net_if.h>
#include <zephyr/net/net_core.h>
#include <zephyr/net/net_context.h>
#include <zephyr/net/net_mgmt.h>


#include <golioth/client.h>
#include <samples/common/sample_credentials.h>
#include <samples/common/net_connect.h>

#if IS_ENABLED(CONFIG_NET_L2_ETHERNET)
#include <zephyr/net/net_if.h>
#endif


#define DHCP_OPTION_NTP (42)

static uint8_t ntp_server[4];
static struct net_mgmt_event_callback mgmt_cb;
static struct net_dhcpv4_option_callback dhcp_cb;
bool assigned_ip = 0;


static void start_dhcpv4_client(struct net_if *iface, void *user_data)
{
	ARG_UNUSED(user_data);

	LOG_INF("Start on %s: index=%d", net_if_get_device(iface)->name,
		net_if_get_by_iface(iface));
	net_dhcpv4_start(iface);
}

static void handler(struct net_mgmt_event_callback *cb,
		    uint32_t mgmt_event,
		    struct net_if *iface)
{
	int i = 0;

	if (mgmt_event != NET_EVENT_IPV4_ADDR_ADD) {
		return;
	}

	for (i = 0; i < NET_IF_MAX_IPV4_ADDR; i++) {
		char buf[NET_IPV4_ADDR_LEN];

		if (iface->config.ip.ipv4->unicast[i].ipv4.addr_type !=
							NET_ADDR_DHCP) {
			continue;
		}

		LOG_INF("   Address[%d]: %s", net_if_get_by_iface(iface),
			net_addr_ntop(AF_INET,
			    &iface->config.ip.ipv4->unicast[i].ipv4.address.in_addr,
						  buf, sizeof(buf)));
		LOG_INF("    Subnet[%d]: %s", net_if_get_by_iface(iface),
			net_addr_ntop(AF_INET,
				       &iface->config.ip.ipv4->unicast[i].netmask,
				       buf, sizeof(buf)));
		LOG_INF("    Router[%d]: %s", net_if_get_by_iface(iface),
			net_addr_ntop(AF_INET,
						 &iface->config.ip.ipv4->gw,
						 buf, sizeof(buf)));
		LOG_INF("Lease time[%d]: %u seconds", net_if_get_by_iface(iface),
			iface->config.dhcpv4.lease_time);

		assigned_ip = 1;
	}
}

static void option_handler(struct net_dhcpv4_option_callback *cb,
			   size_t length,
			   enum net_dhcpv4_msg_type msg_type,
			   struct net_if *iface)
{
	char buf[NET_IPV4_ADDR_LEN];

	LOG_INF("DHCP Option %d: %s", cb->option,
		net_addr_ntop(AF_INET, cb->data, buf, sizeof(buf)));
}

int main(void)
{
	int counter = 0;
	struct golioth_client *client;
	const struct golioth_client_config *client_config;

	LOG_INF("Run dhcpv4 client");

	net_mgmt_init_event_callback(&mgmt_cb, handler,
				     NET_EVENT_IPV4_ADDR_ADD);
	net_mgmt_add_event_callback(&mgmt_cb);

	net_dhcpv4_init_option_callback(&dhcp_cb, option_handler,
					DHCP_OPTION_NTP, ntp_server,
					sizeof(ntp_server));

	net_dhcpv4_add_option_callback(&dhcp_cb);

	net_if_foreach(start_dhcpv4_client, NULL);

	while(assigned_ip == 0){
        LOG_INF("Waiting IP...");
        k_sleep(K_SECONDS(1));
	}	
	

	LOG_INF("IP ADDRESS CONFIGURED! %d", counter);
	LOG_ERR("IP ADDRESS CONFIGURED! %d", counter);
	k_sleep(K_SECONDS(3));

	client_config = golioth_sample_credentials_get();
    client = golioth_client_create(client_config);

    while (true)
    {
        LOG_INF("Sending hello! %d", counter);

        ++counter;
        k_sleep(K_SECONDS(5));
    }

	return 0;
}
```
