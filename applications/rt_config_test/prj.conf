## CMakeLists.txt
```
cmake_minimum_required(VERSION 3.20.0)

find_package(Zephyr REQUIRED HINTS $ENV{ZEPHYR_BASE})
project(hello_zephyr)

target_sources(app PRIVATE  src/main.c
                            )


                            
```

## prj.conf
```kconfig
CONFIG_SHELL=y
CONFIG_SERIAL=y
CONFIG_CONSOLE=y
CONFIG_UART_LINE_CTRL=y
CONFIG_UART_CONSOLE=y
CONFIG_SHELL_BACKEND_SERIAL=y
CONFIG_STDOUT_CONSOLE=y
CONFIG_SHELL_PROMPT_UART="bug_node>"
CONFIG_UART_CONSOLE=y

#CONFIG_RTT_CONSOLE=y
#CONFIG_USE_SEGGER_RTT=y

CONFIG_LOG=y
CONFIG_LOG_BUFFER_SIZE=16384
CONFIG_PRINTK=y



#USB
CONFIG_USB_DEVICE_STACK=y
CONFIG_USB_DEVICE_PRODUCT="Bug node"
CONFIG_USB_DEVICE_PID=0x0004
CONFIG_USB_DEVICE_INITIALIZE_AT_BOOT=n

CONFIG_I2S=y
CONFIG_SERIAL=y
CONFIG_UART_USE_RUNTIME_CONFIGURE=y
CONFIG_PWM=y
CONFIG_PWM_LOG_LEVEL_DBG=n
CONFIG_GPIO=y

#RT CONFIG REQUIRED
CONFIG_RT_CONFIG=y
CONFIG_FLASH=y
CONFIG_FLASH_PAGE_LAYOUT=y
CONFIG_NVS=y

# NEWLIB C
CONFIG_NEWLIB_LIBC=y
CONFIG_NEWLIB_LIBC_FLOAT_PRINTF=y
# cJSON
#CONFIG_CJSON_LIB=y



#define USB_DESC_VID           0x239A
#define USB_DESC_UF2_PID       0x0029


CONFIG_ADC=y

CONFIG_LED_STRIP=y
CONFIG_LED_STRIP_LOG_LEVEL_DBG=n



CONFIG_MAIN_STACK_SIZE=8192
CONFIG_SYSTEM_WORKQUEUE_STACK_SIZE=8192
CONFIG_ISR_STACK_SIZE=4096


CONFIG_NO_OPTIMIZATIONS=n
CONFIG_REBOOT=y
CONFIG_LOG_CMDS=y
```

## src/main.c
```c
#include <zephyr/kernel.h>
#include <zephyr/logging/log.h>
#include <zephyr/shell/shell.h>
#include "rt_config.h"
#include <stdio.h>

static int monkey_handler(const struct shell *shell, 
                      size_t argc,
                      char **argv)
{
   ARG_UNUSED(argc);
   ARG_UNUSED(argv);

   shell_fprintf(shell,SHELL_VT100_COLOR_YELLOW,"\r\n");
   shell_fprintf(shell,SHELL_VT100_COLOR_YELLOW,"                 ██████████████████████████            \r\n");
   shell_fprintf(shell,SHELL_VT100_COLOR_YELLOW,"               ██▒▒▒▒▒▒▒▒▒▒▒▒▒▒▒▒▒▒▒▒▒▒▒▒▒▒██          \r\n");
   shell_fprintf(shell,SHELL_VT100_COLOR_YELLOW,"               ██▒▒▒▒▒▒▒▒▒▒▒▒▒▒▒▒▒▒▒▒▒▒▒▒▒▒▒▒██        \r\n");
   shell_fprintf(shell,SHELL_VT100_COLOR_YELLOW,"             ██▒▒▒▒░░░░░░▒▒▒▒▒▒▒▒▒▒▒▒▒▒▒▒░░░░██        \r\n");
   shell_fprintf(shell,SHELL_VT100_COLOR_YELLOW,"         ██████▒▒░░░░░░░░░░▒▒▒▒▒▒▒▒▒▒▒▒░░░░░░░░██      \r\n");
   shell_fprintf(shell,SHELL_VT100_COLOR_YELLOW,"       ██░░░░░░▒▒░░░░░░░░░░░░░░░░░░░░░░░░░░░░░░██████  \r\n");
   shell_fprintf(shell,SHELL_VT100_COLOR_YELLOW,"       ██░░░░░░▒▒░░░░░░░░░░░░░░░░░░░░░░░░░░░░░░██░░░░██\r\n");
   shell_fprintf(shell,SHELL_VT100_COLOR_YELLOW,"       ██░░░░░░▒▒░░░░░░░░░░██░░░░░░░░██░░░░░░░░██░░░░██\r\n");
   shell_fprintf(shell,SHELL_VT100_COLOR_YELLOW,"         ████░░▒▒░░░░░░░░░░██░░░░░░░░██░░░░░░░░██████  \r\n");
   shell_fprintf(shell,SHELL_VT100_COLOR_YELLOW,"             ██▒▒░░░░░░░░░░░░░░░░░░░░░░░░░░░░░░██      \r\n");
   shell_fprintf(shell,SHELL_VT100_COLOR_YELLOW,"     ████      ██▒▒░░░░░░░░░░░░░░░░░░░░░░░░░░██        \r\n");
   shell_fprintf(shell,SHELL_VT100_COLOR_YELLOW,"   ██    ██      ██▒▒░░░░░░░░░░░░░░░░░░░░░░██          \r\n");
   shell_fprintf(shell,SHELL_VT100_COLOR_YELLOW,"   ██  ██      ██▒▒▒▒▒▒▒▒▒▒▒▒▒▒▒▒▒▒▒▒▒▒▒▒▒▒▒▒██        \r\n");
   shell_fprintf(shell,SHELL_VT100_COLOR_YELLOW,"   ██          ██▒▒▒▒▒▒▒▒░░░░░░░░░░░░▒▒▒▒▒▒▒▒██        \r\n");
   shell_fprintf(shell,SHELL_VT100_COLOR_YELLOW,"     ████    ██▒▒▒▒▒▒▒▒░░░░░░░░░░░░░░░░▒▒▒▒▒▒▒▒██      \r\n");
   shell_fprintf(shell,SHELL_VT100_COLOR_YELLOW,"         ██████▒▒▒▒▒▒▒▒░░░░░░░░░░░░░░░░▒▒▒▒▒▒▒▒██      \r\n");
   shell_fprintf(shell,SHELL_VT100_COLOR_YELLOW,"             ██▒▒▒▒██▒▒░░░░░░░░░░░░░░░░▒▒██▒▒▒▒██      \r\n");
   shell_fprintf(shell,SHELL_VT100_COLOR_YELLOW,"               ██████▒▒▒▒░░░░░░░░░░░░▒▒▒▒██████        \r\n");
   shell_fprintf(shell,SHELL_VT100_COLOR_YELLOW,"                   ██▒▒▒▒▒▒████████▒▒▒▒▒▒██            \r\n");
   shell_fprintf(shell,SHELL_VT100_COLOR_YELLOW,"                   ██░░░░██        ██░░░░██            \r\n");
   shell_fprintf(shell,SHELL_VT100_COLOR_YELLOW,"                   ██████            ██████            \r\n");
   shell_fprintf(shell,SHELL_VT100_COLOR_YELLOW,"\r\n");
   shell_fprintf(shell,SHELL_VT100_COLOR_CYAN,"                          I'm Super\r\n");
      
   return 0;
}

SHELL_CMD_REGISTER(monkey, NULL, "I'm super.", monkey_handler);

LOG_MODULE_REGISTER(main);

uint32_t CONFIG__BUG_FLASH_T_MS;
uint32_t boot_times;

RT_CONFIG_ITEM(bug_flash_time_ms,
    "how long a cricket shoudl flash for when awake",
    &CONFIG__BUG_FLASH_T_MS,
    RT_CONFIG_DATA_TYPE_UINT32,
    sizeof(CONFIG__BUG_FLASH_T_MS),
    "10",
    "2000",
    "100");

RT_CONFIG_ITEM(bug_boot_times,
    "how many device has booted",
    &boot_times,
    RT_CONFIG_DATA_TYPE_UINT32,
    sizeof(boot_times),
    "0",
    "10000",
    "0");


struct rt_config_item *ci = NULL;
char str_boot_times[10] = {0};

int main(void)
{
    LOG_INF("Hello Zephyr!");

    boot_times++;
    sprintf(str_boot_times, "%d", boot_times);

     // Find and store value in rt_configs
     ci = rt_config_get_config_item("bug_boot_times");
     if (ci == NULL)
     {
         LOG_ERR("%s not found in rtconfig storage", "bug_boot_times");
     }
     else
     {
         rt_config_load_with_value(ci, str_boot_times);
         rt_config_export();
         //get_single(shell_backend_uart_get_ptr(), set_rtconfig_cmd.config_var);
     }

    while (1)
    {   
        LOG_INF("Hello World! %d", boot_times);
        k_sleep(K_MSEC(500));
    }
    
	return 0;
}
```
